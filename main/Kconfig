## main/Kconfig
```kconfig
menu "GSM PPPoS configuration"

config GSM_DEBUG
    bool "Enable GSM debugging"
    default y
    help
        Show GSM debug messages

config GSM_TX
    int "UART Output to GSM Module"
    default 21
    range 1 30
    help
	UART Tx pin, connected to GSM Module Rx pin.

config GSM_RX
    int "UART Input from GSM Module"
    default 31
    range 1 38
    help
	UART Rx pin, connected to GSM Module Tx pin.

config GSM_BDRATE
    int "UART Baud rate"
    default 115200
    help
	UART baudrate to comunicate with GSM module

config GSM_INTERNET_USER
    string "Internet User"
	default ""
	help
		Network provider internet user.

config GSM_INTERNET_PASSWORD
    string "Internet password"
	default ""
	help
		Network provider internet password
		
config GSM_APN
    string "Internet APN"
    default "providerAPN"
    help
       Network provider's APN for internet access

config GSM_USE_WIFI_AP
    bool "Start WiFi and AP"
    default n
    help
        Start WiFi as Acces Point and create WebServer task

config GSM_SEND_SMS
    bool "Send SMS message"
    default n
    help
        Send SMS messages during example run

config GSM_SMS_NUMBER
    string "SMS number"
   	depends on GSM_SEND_SMS
    default "+1998765432"
    help
       SMS number for sending messages
       Enter the number in international format (+123999876543)

config GSM_SMS_INTERVAL
    int "SMS message interval"
   	depends on GSM_SEND_SMS
    default 300000
    range 180000 3600000
    help
	Set SMS message interval in mili seconds

endmenu
```

## sdkconfig.defaults
```kconfig
# Override some defaults to enable PPP
CONFIG_PPP_SUPPORT=y
CONFIG_PPP_PAP_SUPPORT=y
CONFIG_PPP_DEBUG_ON=n
CONFIG_TCPIP_TASK_STACK_SIZE=4096
CONFIG_ESP32_DEFAULT_CPU_FREQ_240=y
CONFIG_FREERTOS_HZ=1000
CONFIG_FREERTOS_THREAD_LOCAL_STORAGE_POINTERS=2
CONFIG_ESPTOOLPY_AFTER_NORESET=y
```
